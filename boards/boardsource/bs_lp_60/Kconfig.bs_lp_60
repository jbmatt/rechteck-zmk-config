## boards/boardsource/bs_lp_60/Kconfig.bs_lp_60
```kconfig
# Copyright (c) 2024 Cole Smith
# SPDX-License-Identifier: MIT

config BOARD_BS_LP_60
	select SOC_NRF52840_QIAA
	select ZMK_BOARD_COMPAT if BOARD_BS_LP_60_NRF52840_ZMK
	imply RETAINED_MEM if BOARD_BS_LP_60_NRF52840_ZMK
	imply RETENTION if BOARD_BS_LP_60_NRF52840_ZMK
	imply RETENTION_BOOT_MODE if BOARD_BS_LP_60_NRF52840_ZMK
```

## boards/boardsource/bs_lp_60/board.yml
```yaml
board:
  name: bs_lp_60
  vendor: boardsource
  socs:
    - name: nrf52840
      variants:
        - name: zmk
```
